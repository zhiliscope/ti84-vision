## firmware/main/Kconfig.projbuild
```kconfig
menu "TI Vision hardware gates"
config TV_COMPILE_CHECK
    bool "Compile all modules for API checking; app_main refuses operation"
    default n
config TV_POWER_APPROVED
    bool "Board supply, isolation, host budget and adapter verified"
    default n
    help
        USB is not installed until this is acknowledged. See docs/HARDWARE.md.
config TV_SELF_POWERED
    bool "Board is isolated and self powered with host VBUS sensing"
    default n
config TV_VBUS_GPIO
    int "GPIO connected to verified host VBUS divider/comparator"
    depends on TV_SELF_POWERED
    range 0 48
    default 0
config TV_USB_MILESTONE_PASSED
    bool "Real calculator USB PING/PONG milestone has passed"
    default n
config TV_ENABLE_CAMERA
    bool "Enable experimental camera module (verified board_pins.h required)"
    depends on TV_USB_MILESTONE_PASSED
    default n
config TV_ENABLE_NETWORK
    bool "Enable experimental Wi-Fi / HTTPS module"
    depends on TV_ENABLE_CAMERA
    default n
endmenu
```

## firmware/sdkconfig.defaults
```kconfig
CONFIG_ESPTOOLPY_FLASHSIZE_16MB=y
CONFIG_SPIRAM=y
CONFIG_SPIRAM_MODE_OCT=y
CONFIG_SPIRAM_SPEED_80M=y
CONFIG_SPIRAM_IGNORE_NOTFOUND=y
CONFIG_ESP_CONSOLE_UART_DEFAULT=y
CONFIG_ESP_CONSOLE_SECONDARY_NONE=y
CONFIG_TINYUSB_CDC_ENABLED=y
CONFIG_TINYUSB_CDC_COUNT=1
CONFIG_TINYUSB_CDC_RX_BUFSIZE=512
CONFIG_TINYUSB_CDC_TX_BUFSIZE=512
CONFIG_MBEDTLS_CERTIFICATE_BUNDLE=y
CONFIG_PARTITION_TABLE_SINGLE_APP_LARGE=y
CONFIG_ESP_MAIN_TASK_STACK_SIZE=8192
```
